## zephyr-application/west.yml
```yaml
manifest:
  version: "0.13"

  remotes:
    - name: zephyrproject-rtos
      url-base: https://github.com/zephyrproject-rtos

  projects:
    - name: zephyr
      remote: zephyrproject-rtos
      revision: v4.3.0
      import:
        name-allowlist:
          - cmsis
          - cmsis_6
          - hal_stm32
          - hal_nxp
          - open-amp
          - libmetal
          - picolibc
```
